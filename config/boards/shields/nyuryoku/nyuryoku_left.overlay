#include "nyuryoku.dtsi" 

#include <dt-bindings/zmk/matrix_transform.h>

&left_one_encoder {
    status = "okay";
    #sensor-binding-cells = <0>;
};
&left_two_encoder {
    status = "okay";
    #sensor-binding-cells = <0>;
};
