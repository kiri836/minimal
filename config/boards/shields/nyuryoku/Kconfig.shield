## config/boards/shields/nyuryoku/Kconfig.shield
```kconfig
config SHIELD_MY_BOARD_LEFT
    def_bool $(shields_list_contains,nyuryoku_left)

config SHIELD_MY_BOARD_RIGHT
    def_bool $(shields_list_contains,nyuryoku_right)
```
